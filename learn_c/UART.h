
/************************************UART initialization****************************************************************************/
void intUART(void)
 {
  PINSEL0 = 0x05; /*Select the UART Function */
  U0LCR = 0x83;	/* 8 bit mode and DLAB=1 for Setting the baud rate*/
  U0DLL = 0x87;	/*for Setting the Baud rate Pclk/(UART*16 )= 391, 0x0187*/
  U0DLM = 0x01;
  U0LCR = 0x03;	/* 8 bit mode and DLAB=0 for accesing U0THR and U0RBR */
 }
/**********************************************************************************************************************************/

/**************************************UART Taansmit Charactor*********************************************************************/
void TxUART(unsigned char mydata)
 {
  U0THR = mydata;
  while((U0LSR & (1<<5)));
 }
/*********************************************************************************************************************************/

/**************************************UART Receive Charactor**********************************************************************/
unsigned char RxUART(void)
 {
  unsigned char read;
  while((U0LSR & (0x01)));
  read = U0RBR;
  return read;
 }
/********************************************************************************************************************************/

/**********************************Transmit String********************************************************************************/
void TxString(unsigned char str[20])
 {
  int i=0;
  while(str[i] != '\0')
  {
   TxUART(str[i]);
   i++;
  }
 }
/********************************************************************************************************************************/

/**********************************UART Intrrupt********************************************************************************/



























